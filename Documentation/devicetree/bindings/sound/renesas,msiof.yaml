## Documentation/devicetree/bindings/sound/renesas,msiof.yaml
```yaml
# SPDX-License-Identifier: GPL-2.0
%YAML 1.2
---
$id: http://devicetree.org/schemas/sound/renesas,msiof.yaml#
$schema: http://devicetree.org/meta-schemas/core.yaml#

title: Renesas MSIOF I2S controller

maintainers:
  - Kuninori Morimoto <kuninori.morimoto.gx@renesas.com>

# sharing with MSIOF SPI
# see
# ${LINUX}/Documentation/devicetree/bindings/spi/renesas,sh-msiof.yaml
select:
  properties:
    compatible:
      contains:
        pattern: "renesas,.*-msiof"
  required:
    - compatible
    - port

properties:
  compatible:
    items:
      - const: renesas,msiof-r8a779g0   # R-Car V4H
      - const: renesas,rcar-gen4-msiof  # generic R-Car Gen4

  reg:
    minItems: 1
    maxItems: 2
    oneOf:
      - items:
          - description: CPU and DMA engine registers
      - items:
          - description: CPU registers
          - description: DMA engine registers

  interrupts:
    maxItems: 1

  clocks:
    maxItems: 1

  power-domains:
    maxItems: 1

  resets:
    maxItems: 1

  dmas:
    minItems: 2
    maxItems: 4

  dma-names:
    minItems: 2
    maxItems: 4
    items:
      enum: [ tx, rx ]

  port:
    $ref: audio-graph-port.yaml#/definitions/port-base
    unevaluatedProperties: false
    patternProperties:
      "^endpoint(@[0-9a-f]+)?":
        $ref: audio-graph-port.yaml#/definitions/endpoint-base

required:
  - compatible
  - reg
  - interrupts
  - clocks
  - power-domains
  - port

unevaluatedProperties: false

examples:
  - |
    #include <dt-bindings/clock/r8a779g0-cpg-mssr.h>
    #include <dt-bindings/interrupt-controller/arm-gic.h>
    #include <dt-bindings/power/r8a779g0-sysc.h>

    dummy-codec {
      compatible = "test-codec";

      port {
        codec_ep: endpoint {
          remote-endpoint = <&msiof1_snd_ep>;
        };
      };
    };

    msiof1: serial@e6ea0000 {
      compatible = "renesas,msiof-r8a779g0",
                   "renesas,rcar-gen4-msiof";
      reg = <0 0xe6ea0000 0 0x0064>;
      interrupts = <GIC_SPI 240 IRQ_TYPE_LEVEL_HIGH>;
      clocks = <&cpg CPG_MOD 619>;
      dmas = <&dmac0 0x43>, <&dmac0 0x42>,
             <&dmac1 0x43>, <&dmac1 0x42>;
      dma-names = "tx", "rx", "tx", "rx";
      power-domains = <&sysc R8A779G0_PD_ALWAYS_ON>;
      resets = <&cpg 619>;

      port {
        msiof1_snd_ep: endpoint {
          remote-endpoint = <&codec_ep>;
        };
      };
    };
```
